
//=============================================================================
//
// XLINK configuration file
//
//=============================================================================

// Demo Code Usage Restrictions:
// Elmos Semiconductor SE provides this source code file simply and solely for 
// IC evaluation purposes in laboratory and this file must not be used for other 
// purposes or within non laboratory environments. Especially, the use or the 
// integration in production systems, appliances or other installations is 
// prohibited.
// 
// Disclaimer:
// Elmos Semiconductor SE shall not be liable for any damages arising out of 
// defects resulting from 
// (1) delivered hardware or software, 
// (2) non observance of instructions contained in this document, or 
// (3) misuse, abuse, use under abnormal conditions or alteration by anyone 
// other than Elmos Semiconductor SE. To the extend permitted by law 
// Elmos Semiconductor SE hereby expressively disclaims and user expressively 
// waives any and all warranties of merchantability and of fitness for a 
// particular purpose, statutory warranty of non-infringement and any other 
// warranty or product liability that may arise by reason of usage of trade, 
// custom or course of dealing.

// read/write (data) segments
//
// segment         usage
// -------         --------------------------
// DATA16_Z        data initialized to zero
// DATA16_I        data initialized by copying from DATA16_ID
// DATA16_N        data defined using __no_init
// DATA16_HEAP     heap used by 'malloc' and 'free'
// CSTACK          runtime stack
//
// read-only (program and data) segments
//
// segment         usage
// -------         --------------------------
// DATA16_C        constant data, including string literals
// DATA16_ID       initializers for DATA<nn>_I
// CSTART          program startup code
// CODE            program code
// ISR_CODE        program code for interrupt service routines
// DIFUNCT         dynamic initialization vector used by C++
// CHECKSUM        checksum byte(s) generated by the -J option
// INTVEC          interrupt vectors
// RESET           reset vector

//=============================================================================
// stack and heap sizes

//-D_STACK_SIZE=80
//-D_DATA16_HEAP_SIZE=80

//=============================================================================
// CPU type

-cmsp430

//=============================================================================
// support for placing functions in read/write memory
-QCODE_I=CODE_ID

//=============================================================================
// read/write memory

-Z(DATA)DATA16_I,DATA16_Z,DATA16_N,DATA16_HEAP+_DATA16_HEAP_SIZE=0800-0FFF
-Z(DATA)CODE_I
-Z(DATA)CSTACK+_STACK_SIZE#

//=============================================================================
// read-only memory

-Z(CONST)APP_VERSION=8000-8035
-Z(CONST)DATA16_C,DATA16_ID,DIFUNCT,CHECKSUM=8036-FFFD
-Z(CODE)CSTART,ISR_CODE,CODE_ID,CODE=8036-FFFD

//=============================================================================
// interrupt vectors

-Z(CODE)RESET=FFFE-FFFF
//-Z(DATA)APP_CRC=FFFE-FFFF

//=============================================================================

